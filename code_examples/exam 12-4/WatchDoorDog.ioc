# file: WatchDoorDog.ioc
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Mcu.Family=STM32F1
Mcu.Name=STM32F103C(8-B)Tx
Mcu.Package=LQFP48
NVIC.PriorityGroup=NVIC_PRIORITYGROUP_4
PA10.Signal=USART1_RX
PA13.Signal=SYS_JTMS-SWDIO
PA14.Signal=SYS_JTCK-SWCLK
PA9.Signal=USART1_TX
PC13-TAMPER-RTC.Signal=GPIO_Output
ProjectManager.HeapSize=0x200
ProjectManager.StackSize=0x400
ProjectManager.TargetToolchain=STM32CubeIDE
RCC.APB1Freq_Value=8000000
RCC.APB2Freq_Value=8000000
board=custom

// file: Core/Src/main.c
/* USER CODE BEGIN Header */
/**
  ******************************************************************************
  * @file           : main.c
  * @brief          : Main program body
  ******************************************************************************
  * @attention
  *
  * Copyright (c) 2026 STMicroelectronics.
  * All rights reserved.
  *
  * This software is licensed under terms that can be found in the LICENSE file
  * in the root directory of this software component.
  * If no LICENSE file comes with this software, it is provided AS-IS.
  *
  ******************************************************************************
  */
/* USER CODE END Header */
#include "main.h"

/* USER CODE BEGIN PTD */
/* 配置参数结构体 */
typedef struct {
    uint16_t device_id;
    float threshold;
    uint32_t magic_num; // 用于校验参数是否有效
} Config_t;

#define CONFIG_MAGIC  0x5A5A1234

typedef enum
{
  APP_OK = 0,
  APP_FLASH_ERASE_ERROR,
  APP_FLASH_WRITE_ERROR,
  APP_FLASH_VERIFY_ERROR
} AppStatus_t;
/* USER CODE END PTD */

/* USER CODE BEGIN PD */
#define PARAM_PAGE_ADDR       0x0800FC00U
#define APP_LED_GPIO_Port     GPIOC
#define APP_LED_Pin           GPIO_PIN_13
/* USER CODE END PD */

/* USER CODE BEGIN PV */
Config_t g_config;
IWDG_HandleTypeDef hiwdg;
/* USER CODE END PV */

void SystemClock_Config(void);
static void MX_GPIO_Init(void);
/* USER CODE BEGIN PFP */
static void WDG_Init(void);
static void Param_Load(Config_t *conf);
static void Param_Save(Config_t *conf);
/* USER CODE END PFP */

/* USER CODE BEGIN 0 */
/* 模拟传感器读取函数 */
float Read_Sensor(void) {
    return 26.5f; // 模拟返回正常温度
}
/* USER CODE END 0 */

int main(void)
{

  /* MCU Configuration--------------------------------------------------------*/

  /* Reset of all peripherals, Initializes the Flash interface and the Systick. */
  HAL_Init();

  /* Configure the system clock */
  SystemClock_Config();

  /* Initialize all configured peripherals */
  MX_GPIO_Init();

  /* 1. 恢复参数 */
  Param_Load(&g_config);
  if (g_config.magic_num != CONFIG_MAGIC) {
      g_config.device_id = 0x0001;
      g_config.threshold = 25.5f;
      g_config.magic_num = CONFIG_MAGIC;
      Param_Save(&g_config);
  }

  /* 2. 启动看门狗 (1s 超时) */
  WDG_Init();

  /* USER CODE BEGIN 2 */
  // 启动成功指示
  HAL_GPIO_WritePin(APP_LED_GPIO_Port, APP_LED_Pin, GPIO_PIN_RESET);
  HAL_Delay(200);
  HAL_GPIO_WritePin(APP_LED_GPIO_Port, APP_LED_Pin, GPIO_PIN_SET);
  /* USER CODE END 2 */

  /* Infinite loop */
  /* USER CODE BEGIN WHILE */
  while (1)
  {
    // 3. 模拟业务逻辑
    float temp = Read_Sensor();

    // 异常判断：如果温度超出范围，进入错误处理（停止喂狗等待重启）
    if (temp > 100.0f || temp < -40.0f) {
        Error_Handler();
    }

    // 4. 及时喂狗
    HAL_IWDG_Refresh(&hiwdg);

    // 指示灯闪烁，表示系统正常运行
    HAL_GPIO_TogglePin(APP_LED_GPIO_Port, APP_LED_Pin);
    HAL_Delay(200);
    /* USER CODE END WHILE */

  }
}

void SystemClock_Config(void)
{
  RCC_OscInitTypeDef RCC_OscInitStruct = {0};
  RCC_ClkInitTypeDef RCC_ClkInitStruct = {0};

  /** Initializes the RCC Oscillators according to the specified parameters
  * in the RCC_OscInitTypeDef structure.
  */
  RCC_OscInitStruct.OscillatorType = RCC_OSCILLATORTYPE_HSI;
  RCC_OscInitStruct.HSIState = RCC_HSI_ON;
  RCC_OscInitStruct.HSICalibrationValue = RCC_HSICALIBRATION_DEFAULT;
  RCC_OscInitStruct.PLL.PLLState = RCC_PLL_NONE;
  if (HAL_RCC_OscConfig(&RCC_OscInitStruct) != HAL_OK)
  {
    Error_Handler();
  }

  /** Initializes the CPU, AHB and APB buses clocks
  */
  RCC_ClkInitStruct.ClockType = RCC_CLOCKTYPE_HCLK|RCC_CLOCKTYPE_SYSCLK
                              |RCC_CLOCKTYPE_PCLK1|RCC_CLOCKTYPE_PCLK2;
  RCC_ClkInitStruct.SYSCLKSource = RCC_SYSCLKSOURCE_HSI;
  RCC_ClkInitStruct.AHBCLKDivider = RCC_SYSCLK_DIV1;
  RCC_ClkInitStruct.APB1CLKDivider = RCC_HCLK_DIV1;
  RCC_ClkInitStruct.APB2CLKDivider = RCC_HCLK_DIV1;

  if (HAL_RCC_ClockConfig(&RCC_ClkInitStruct, FLASH_LATENCY_0) != HAL_OK)
  {
    Error_Handler();
  }
}

static void MX_GPIO_Init(void)
{
  GPIO_InitTypeDef GPIO_InitStruct = {0};

  /* GPIO Ports Clock Enable */
  __HAL_RCC_GPIOC_CLK_ENABLE();
  __HAL_RCC_GPIOD_CLK_ENABLE();
  __HAL_RCC_GPIOA_CLK_ENABLE();

  /*Configure GPIO pin Output Level */
  HAL_GPIO_WritePin(GPIOC, GPIO_PIN_13, GPIO_PIN_SET);

  /*Configure GPIO pin : PC13 */
  GPIO_InitStruct.Pin = GPIO_PIN_13;
  GPIO_InitStruct.Mode = GPIO_MODE_OUTPUT_PP;
  GPIO_InitStruct.Pull = GPIO_NOPULL;
  GPIO_InitStruct.Speed = GPIO_SPEED_FREQ_LOW;
  HAL_GPIO_Init(GPIOC, &GPIO_InitStruct);

  /*Configure GPIO pin : PA9 */
  GPIO_InitStruct.Pin = GPIO_PIN_9;
  GPIO_InitStruct.Mode = GPIO_MODE_AF_PP;
  GPIO_InitStruct.Speed = GPIO_SPEED_FREQ_HIGH;
  HAL_GPIO_Init(GPIOA, &GPIO_InitStruct);

  /*Configure GPIO pin : PA10 */
  GPIO_InitStruct.Pin = GPIO_PIN_10;
  GPIO_InitStruct.Mode = GPIO_MODE_INPUT;
  GPIO_InitStruct.Pull = GPIO_NOPULL;
  HAL_GPIO_Init(GPIOA, &GPIO_InitStruct);

}

/* USER CODE BEGIN 4 */
/**
 * @brief IWDG 初始化 (使用 HAL 库)
 */
void WDG_Init(void) {
    hiwdg.Instance = IWDG;
    hiwdg.Init.Prescaler = IWDG_PRESCALER_64;
    hiwdg.Init.Reload = 625; // 1秒超时 (40kHz/64 = 625Hz)
    HAL_IWDG_Init(&hiwdg);
}

/**
 * @brief 保存配置参数到 Flash
 */
void Param_Save(Config_t *conf) {
    FLASH_EraseInitTypeDef erase;
    uint32_t error;

    HAL_FLASH_Unlock();
    erase.TypeErase = FLASH_TYPEERASE_PAGES;
    erase.PageAddress = PARAM_PAGE_ADDR;
    erase.NbPages = 1;

    if (HAL_FLASHEx_Erase(&erase, &error) == HAL_OK) {
        uint16_t *pData = (uint16_t *)conf;
        for (uint16_t i = 0; i < sizeof(Config_t); i += 2) {
            HAL_FLASH_Program(FLASH_TYPEPROGRAM_HALFWORD, PARAM_PAGE_ADDR + i, *pData++);
        }
    }
    HAL_FLASH_Lock();
}

/**
 * @brief 从 Flash 读取配置参数
 */
void Param_Load(Config_t *conf) {
    memcpy(conf, (void*)PARAM_PAGE_ADDR, sizeof(Config_t));
}
/* USER CODE END 4 */

void Error_Handler(void)
{
  /* USER CODE BEGIN Error_Handler_Debug */
  __disable_irq();
  while (1)
  {
    HAL_GPIO_TogglePin(APP_LED_GPIO_Port, APP_LED_Pin);
    for (volatile uint32_t i = 0; i < 300000U; i++) { }
  }
  /* USER CODE END Error_Handler_Debug */
}
